## RaspPi4B_Yocto/meta-RFuCBootloader/conf/layer.conf
```bitbake
# We have a conf and classes directory, add to BBPATH
BBPATH .= ":${LAYERDIR}"

# We have recipes-* directories, add to BBFILES
BBFILES += "${LAYERDIR}/recipes-*/*/*.bb \
            ${LAYERDIR}/recipes-*/*/*.bbappend"

BBFILE_COLLECTIONS += "meta-RFuCBootloader"
BBFILE_PATTERN_meta-RFuCBootloader = "^${LAYERDIR}/"
BBFILE_PRIORITY_meta-RFuCBootloader = "6"

LAYERDEPENDS_meta-RFuCBootloader = "core"
LAYERSERIES_COMPAT_meta-RFuCBootloader = "dunfell"
```
